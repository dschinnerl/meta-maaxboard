## conf/local.conf.sample
```bitbake
MACHINE ??= 'maaxboard'
DISTRO ?= 'fsl-imx-wayland-lite'
PACKAGE_CLASSES ?= 'package_deb'
# EXTRA_IMAGE_FEATURES ?= "debug-tweaks"
USER_CLASSES ?= "buildstats image-mklibs image-prelink"
PATCHRESOLVE = "noop"
BB_DISKMON_DIRS ??= "\
    STOPTASKS,${TMPDIR},1G,100K \
    STOPTASKS,${DL_DIR},1G,100K \
    STOPTASKS,${SSTATE_DIR},1G,100K \
    STOPTASKS,/tmp,100M,100K \
    HALT,${TMPDIR},100M,1K \
    HALT,${DL_DIR},100M,1K \
    HALT,${SSTATE_DIR},100M,1K \
    HALT,/tmp,10M,1K"
PACKAGECONFIG:append:pn-qemu-system-native = " sdl"
CONF_VERSION = "2"

#DL_DIR ?= "${HOME}/oe-sources-hardknott/"
ACCEPT_FSL_EULA = "1"


PACKAGE_CLASSES = "package_deb"
EXTRA_IMAGE_FEATURES += "package-management"

LICENSE_FLAGS_ACCEPTED += "commercial "
PACKAGECONFIG:pn-gstreamer1.0-plugins-ugly += "x264"

MAAXBOARD_GIT_HOST_MIRROR = "git://github.com/Avnet"
```
